## boards/shields/cosmoskeyboard/Kconfig.defconfig
```kconfig
if SHIELD_COSMOSKEYBOARD_LEFT

# Name must be less than 16 characters long!
config ZMK_KEYBOARD_NAME
    default "cosmoskeyboard"

config ZMK_SPLIT_ROLE_CENTRAL
    default y

config ZMK_SPLIT_BLE_CENTRAL_PERIPHERALS
  default 1

config BT_MAX_CONN
  default 6

config BT_MAX_PAIRED
  default 6

endif

if SHIELD_COSMOSKEYBOARD_LEFT || SHIELD_COSMOSKEYBOARD_RIGHT

config ZMK_SPLIT
    default y

config ZMK_POINTING
    default y

endif

# ---------------------
# Kconfig for shield "cosmoskeyboard_right" with board "nice_nano_v2"
# ---------------------
if BOARD_NICE_NANO_V2 && SHIELD_COSMOSKEYBOARD_RIGHT

config SPI
    default y

config PMW3610
    default y

endif
```

## boards/shields/cosmoskeyboard/Kconfig.shield
```kconfig
config SHIELD_COSMOSKEYBOARD_LEFT
    def_bool $(shields_list_contains,cosmoskeyboard_left)
  
config SHIELD_COSMOSKEYBOARD_RIGHT
    def_bool $(shields_list_contains,cosmoskeyboard_right)
  
```
